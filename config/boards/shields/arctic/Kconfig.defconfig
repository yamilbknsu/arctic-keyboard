## config/boards/shields/arctic/Kconfig.defconfig
```kconfig
if SHIELD_ARCTIC_LEFT

# Name must be less than 16 characters long!
config ZMK_KEYBOARD_NAME
    default "Arctic"

config ZMK_SPLIT_ROLE_CENTRAL
    default y

endif

if SHIELD_ARCTIC_LEFT || SHIELD_ARCTIC_RIGHT

config ZMK_SPLIT
    default y

endif
```

## config/boards/shields/arctic/Kconfig.shield
```kconfig
# No whitespace after the comma or in your part name!
config SHIELD_ARCTIC_LEFT
    def_bool $(shields_list_contains,arctic_left)

# No whitespace after the comma or in your part name!
config SHIELD_ARCTIC_RIGHT
    def_bool $(shields_list_contains,arctic_right)
```
